## config/boards/shields/dmote/Kconfig.defconfig
```kconfig
if SHIELD_DMOTE_LEFT

config ZMK_KEYBOARD_NAME
	default "DMOTE Left"

config ZMK_SPLIT_BLE_ROLE_CENTRAL
	default y

endif

if SHIELD_DMOTE_RIGHT

config ZMK_KEYBOARD_NAME
	default "DMOTE Right"

endif

if SHIELD_DMOTE_LEFT || SHIELD_DMOTE_RIGHT

config ZMK_SPLIT
	default y

endif
```

## config/boards/shields/dmote/Kconfig.shield
```kconfig
config SHIELD_DMOTE_LEFT
	def_bool $(shields_list_contains,dmote_left)
config SHIELD_DMOTE_RIGHT
	def_bool $(shields_list_contains,dmote_right)
```

## config/west.yml
```yaml
manifest:
  projects:
    - name: zmk
      url: https://github.com/ftc/zmk
      revision: mouse-ftc
      import: app/west.yml
  self:
    path: config
```
