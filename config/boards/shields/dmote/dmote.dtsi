#include <dt-bindings/zmk/matrix_transform.h>
/ {
	chosen {
		zmk,kscan = &bob;
		zmk,matrix_transform = &default_transform;
	};

	default_transform: keymap_transform_0 {
		compatible = "zmk,matrix-transform";
		columns = <12>;
		rows = <7>;
	};

	bob: alice {
		compatible = "zmk,kscan-gpio-matrix";
		label = "KSCAN";

		diode-direction = "col2row";
		row-gpios =
			<&gpio0 6 (GPIO_ACTIVE_HIGH | GPIO_PULL_DOWN)>, //row1
			<&gpio0 8 (GPIO_ACTIVE_HIGH | GPIO_PULL_DOWN)>,
			<&gpio0 17 (GPIO_ACTIVE_HIGH | GPIO_PULL_DOWN)>,
			<&gpio0 20 (GPIO_ACTIVE_HIGH | GPIO_PULL_DOWN)>,
			<&gpio0 22 (GPIO_ACTIVE_HIGH | GPIO_PULL_DOWN)>,
			<&gpio0 24 (GPIO_ACTIVE_HIGH | GPIO_PULL_DOWN)>,
			<&gpio0 11 (GPIO_ACTIVE_HIGH | GPIO_PULL_DOWN)> //row7
		;

	};
};